## drivers/voyager/Kconfig
```kconfig
# SPDX-License-Identifier: GPL-2.0-only

config VOYAGER_ADDON
	tristate "Enable special features added by voyager kernel"
	help
	This will enable additional features.


source "drivers/voyager/sched/Kconfig"

config CHARGE_THERMAL_SKIP
	bool
	default y
	help
	 Skip charge thermal

config MI_THERMAL_SWITCH
	bool
	default y
	help
	 Say Y to control whether use Mi thermal interface
```
